#include <ti/screen.h>
#include <ti/getkey.h>
#include <stdlib.h>
#include <string.h>
#include <stdio.h>

#include "hmac.h"

/*
 * RFC 4231 HMAC-SHA-256 Test Vectors
 * Source: RFC 4231, Section 4
 */

/* Test Case 1: 20-byte key, "Hi There" */
const uint8_t key1[] = {
    0x0b,0x0b,0x0b,0x0b,0x0b,0x0b,0x0b,0x0b,0x0b,0x0b,
    0x0b,0x0b,0x0b,0x0b,0x0b,0x0b,0x0b,0x0b,0x0b,0x0b
};
const uint8_t data1[] = {0x48,0x69,0x20,0x54,0x68,0x65,0x72,0x65}; /* "Hi There" */
const uint8_t expected1[] = {
    0xb0,0x34,0x4c,0x61,0xd8,0xdb,0x38,0x53,0x5c,0xa8,0xaf,0xce,0xaf,0x0b,0xf1,0x2b,
    0x88,0x1d,0xc2,0x00,0xc9,0x83,0x3d,0xa7,0x26,0xe9,0x37,0x6c,0x2e,0x32,0xcf,0xf7
};

/* Test Case 2: "Jefe" key, "what do ya want for nothing?" */
const uint8_t key2[] = {0x4a,0x65,0x66,0x65}; /* "Jefe" */
const uint8_t data2[] = {
    0x77,0x68,0x61,0x74,0x20,0x64,0x6f,0x20,0x79,0x61,0x20,0x77,0x61,0x6e,0x74,0x20,
    0x66,0x6f,0x72,0x20,0x6e,0x6f,0x74,0x68,0x69,0x6e,0x67,0x3f
}; /* "what do ya want for nothing?" */
const uint8_t expected2[] = {
    0x5b,0xdc,0xc1,0x46,0xbf,0x60,0x75,0x4e,0x6a,0x04,0x24,0x26,0x08,0x95,0x75,0xc7,
    0x5a,0x00,0x3f,0x08,0x9d,0x27,0x39,0x83,0x9d,0xec,0x58,0xb9,0x64,0xec,0x38,0x43
};

/* Test Case 3: 20-byte 0xaa key, 50-byte 0xdd data */
const uint8_t key3[] = {
    0xaa,0xaa,0xaa,0xaa,0xaa,0xaa,0xaa,0xaa,0xaa,0xaa,
    0xaa,0xaa,0xaa,0xaa,0xaa,0xaa,0xaa,0xaa,0xaa,0xaa
};
const uint8_t data3[] = {
    0xdd,0xdd,0xdd,0xdd,0xdd,0xdd,0xdd,0xdd,0xdd,0xdd,
    0xdd,0xdd,0xdd,0xdd,0xdd,0xdd,0xdd,0xdd,0xdd,0xdd,
    0xdd,0xdd,0xdd,0xdd,0xdd,0xdd,0xdd,0xdd,0xdd,0xdd,
    0xdd,0xdd,0xdd,0xdd,0xdd,0xdd,0xdd,0xdd,0xdd,0xdd,
    0xdd,0xdd,0xdd,0xdd,0xdd,0xdd,0xdd,0xdd,0xdd,0xdd
};
const uint8_t expected3[] = {
    0x77,0x3e,0xa9,0x1e,0x36,0x80,0x0e,0x46,0x85,0x4d,0xb8,0xeb,0xd0,0x91,0x81,0xa7,
    0x29,0x59,0x09,0x8b,0x3e,0xf8,0xc1,0x22,0xd9,0x63,0x55,0x14,0xce,0xd5,0x65,0xfe
};


/* Main function, called first */
int main(void)
{
    os_ClrHome();
    uint8_t digest[TLS_SHA256_DIGEST_LEN];
    struct tls_hmac_context ctx;

    // Test 1: RFC 4231 Test Case 1
    if(!tls_hmac_context_init(&ctx, TLS_HASH_SHA256, key1, sizeof key1)) return 1;
    ctx.update(&ctx, data1, sizeof data1);
    ctx.digest(&ctx, digest);
    if(memcmp(digest, expected1, TLS_SHA256_DIGEST_LEN)==0)
        printf("success");
    else printf("failed");
    os_GetKey();
    os_ClrHome();

    // Test 2: RFC 4231 Test Case 2
    if(!tls_hmac_context_init(&ctx, TLS_HASH_SHA256, key2, sizeof key2)) return 1;
    ctx.update(&ctx, data2, sizeof data2);
    ctx.digest(&ctx, digest);
    if(memcmp(digest, expected2, TLS_SHA256_DIGEST_LEN)==0)
        printf("success");
    else printf("failed");
    os_GetKey();
    os_ClrHome();

    // Test 3: RFC 4231 Test Case 3
    if(!tls_hmac_context_init(&ctx, TLS_HASH_SHA256, key3, sizeof key3)) return 1;
    ctx.update(&ctx, data3, sizeof data3);
    ctx.digest(&ctx, digest);
    if(memcmp(digest, expected3, TLS_SHA256_DIGEST_LEN)==0)
        printf("success");
    else printf("failed");
    os_GetKey();
    os_ClrHome();
    return 0;
}
