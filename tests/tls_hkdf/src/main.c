/**
 * @file main.c
 * @brief HKDF Test - RFC 5869 Test Vectors
 */

#include <stdbool.h>
#include <stdint.h>
#include <string.h>
#include <graphx.h>
#include <keypadc.h>
#include <debug.h>

/* TLS includes */
#include "hkdf.h"
#include "hash.h"

/* Test result display */
static void print_test_result(const char *test_name, bool passed) {
    gfx_SetTextFGColor(passed ? 2 : 224);  /* Green or red */
    gfx_PrintString(test_name);
    gfx_PrintString(": ");
    gfx_PrintString(passed ? "PASS" : "FAIL");
    gfx_PrintString("\n");
}

/**
 * RFC 5869 Test Case 1
 * Hash = SHA-256
 */
static bool test_hkdf_rfc5869_case1(void) {
    /* Test vector from RFC 5869 A.1 */
    const uint8_t ikm[] = {
        0x0b, 0x0b, 0x0b, 0x0b, 0x0b, 0x0b, 0x0b, 0x0b,
        0x0b, 0x0b, 0x0b, 0x0b, 0x0b, 0x0b, 0x0b, 0x0b,
        0x0b, 0x0b, 0x0b, 0x0b, 0x0b, 0x0b
    };
    const uint8_t salt[] = {
        0x00, 0x01, 0x02, 0x03, 0x04, 0x05, 0x06, 0x07,
        0x08, 0x09, 0x0a, 0x0b, 0x0c
    };
    const uint8_t info[] = {
        0xf0, 0xf1, 0xf2, 0xf3, 0xf4, 0xf5, 0xf6, 0xf7,
        0xf8, 0xf9
    };

    const uint8_t expected_prk[] = {
        0x07, 0x77, 0x09, 0x36, 0x2c, 0x2e, 0x32, 0xdf,
        0x0d, 0xdc, 0x3f, 0x0d, 0xc4, 0x7b, 0xba, 0x63,
        0x90, 0xb6, 0xc7, 0x3b, 0xb5, 0x0f, 0x9c, 0x31,
        0x22, 0xec, 0x84, 0x4a, 0xd7, 0xc2, 0xb3, 0xe5
    };

    const uint8_t expected_okm[] = {
        0x3c, 0xb2, 0x5f, 0x25, 0xfa, 0xac, 0xd5, 0x7a,
        0x90, 0x43, 0x4f, 0x64, 0xd0, 0x36, 0x2f, 0x2a,
        0x2d, 0x2d, 0x0a, 0x90, 0xcf, 0x1a, 0x5a, 0x4c,
        0x5d, 0xb0, 0x2d, 0x56, 0xec, 0xc4, 0xc5, 0xbf,
        0x34, 0x00, 0x72, 0x08, 0xd5, 0xb8, 0x87, 0x18,
        0x58, 0x65
    };

    uint8_t prk[32];
    uint8_t okm[42];

    /* Test HKDF-Extract */
    if (!tls_hkdf_extract(TLS_HASH_SHA256, salt, sizeof(salt),
                          ikm, sizeof(ikm), prk)) {
        return false;
    }

    if (memcmp(prk, expected_prk, sizeof(expected_prk)) != 0) {
        return false;
    }

    /* Test HKDF-Expand */
    if (!tls_hkdf_expand(TLS_HASH_SHA256, prk, sizeof(prk),
                         info, sizeof(info), okm, sizeof(okm))) {
        return false;
    }

    if (memcmp(okm, expected_okm, sizeof(expected_okm)) != 0) {
        return false;
    }

    return true;
}

/**
 * RFC 5869 Test Case 2
 * Hash = SHA-256
 * Longer inputs/outputs
 */
static bool test_hkdf_rfc5869_case2(void) {
    /* Test vector from RFC 5869 A.2 */
    const uint8_t ikm[] = {
        0x00, 0x01, 0x02, 0x03, 0x04, 0x05, 0x06, 0x07,
        0x08, 0x09, 0x0a, 0x0b, 0x0c, 0x0d, 0x0e, 0x0f,
        0x10, 0x11, 0x12, 0x13, 0x14, 0x15, 0x16, 0x17,
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        0x48, 0x49, 0x4a, 0x4b, 0x4c, 0x4d, 0x4e, 0x4f
    };

    const uint8_t salt[] = {
        0x60, 0x61, 0x62, 0x63, 0x64, 0x65, 0x66, 0x67,
        0x68, 0x69, 0x6a, 0x6b, 0x6c, 0x6d, 0x6e, 0x6f,
        0x70, 0x71, 0x72, 0x73, 0x74, 0x75, 0x76, 0x77,
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        0xa8, 0xa9, 0xaa, 0xab, 0xac, 0xad, 0xae, 0xaf
    };

    const uint8_t info[] = {
        0xb0, 0xb1, 0xb2, 0xb3, 0xb4, 0xb5, 0xb6, 0xb7,
        0xb8, 0xb9, 0xba, 0xbb, 0xbc, 0xbd, 0xbe, 0xbf,
        0xc0, 0xc1, 0xc2, 0xc3, 0xc4, 0xc5, 0xc6, 0xc7,
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        0xf8, 0xf9, 0xfa, 0xfb, 0xfc, 0xfd, 0xfe, 0xff
    };

    const uint8_t expected_prk[] = {
        0x06, 0xa6, 0xb8, 0x8c, 0x58, 0x53, 0x36, 0x1a,
        0x06, 0x10, 0x4c, 0x9c, 0xeb, 0x35, 0xb4, 0x5c,
        0xef, 0x76, 0x00, 0x14, 0x90, 0x46, 0x71, 0x01,
        0x4a, 0x19, 0x3f, 0x40, 0xc1, 0x5f, 0xc2, 0x44
    };

    const uint8_t expected_okm[] = {
        0xb1, 0x1e, 0x39, 0x8d, 0xc8, 0x03, 0x27, 0xa1,
        0xc8, 0xe7, 0xf7, 0x8c, 0x59, 0x6a, 0x49, 0x34,
        0x4f, 0x01, 0x2e, 0xda, 0x2d, 0x4e, 0xfa, 0xd8,
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        0x1d, 0x87
    };

    uint8_t prk[32];
    uint8_t okm[82];

    /* Test HKDF-Extract */
    if (!tls_hkdf_extract(TLS_HASH_SHA256, salt, sizeof(salt),
                          ikm, sizeof(ikm), prk)) {
        return false;
    }

    if (memcmp(prk, expected_prk, sizeof(expected_prk)) != 0) {
        return false;
    }

    /* Test HKDF-Expand */
    if (!tls_hkdf_expand(TLS_HASH_SHA256, prk, sizeof(prk),
                         info, sizeof(info), okm, sizeof(okm))) {
        return false;
    }

    if (memcmp(okm, expected_okm, sizeof(expected_okm)) != 0) {
        return false;
    }

    return true;
}

/**
 * RFC 5869 Test Case 3
 * Hash = SHA-256
 * No salt, no info
 */
static bool test_hkdf_rfc5869_case3(void) {
    /* Test vector from RFC 5869 A.3 */
    const uint8_t ikm[] = {
        0x0b, 0x0b, 0x0b, 0x0b, 0x0b, 0x0b, 0x0b, 0x0b,
        0x0b, 0x0b, 0x0b, 0x0b, 0x0b, 0x0b, 0x0b, 0x0b,
        0x0b, 0x0b, 0x0b, 0x0b, 0x0b, 0x0b
    };

    const uint8_t expected_prk[] = {
        0x19, 0xef, 0x24, 0xa3, 0x2c, 0x71, 0x7b, 0x16,
        0x7f, 0x33, 0xa9, 0x1d, 0x6f, 0x64, 0x8b, 0xdf,
        0x96, 0x59, 0x67, 0x76, 0xaf, 0xdb, 0x63, 0x77,
        0xac, 0x43, 0x4c, 0x1c, 0x29, 0x3c, 0xcb, 0x04
    };

    const uint8_t expected_okm[] = {
        0x8d, 0xa4, 0xe7, 0x75, 0xa5, 0x63, 0xc1, 0x8f,
        0x71, 0x5f, 0x80, 0x2a, 0x06, 0x3c, 0x5a, 0x31,
        0xb8, 0xa1, 0x1f, 0x5c, 0x5e, 0xe1, 0x87, 0x9e,
        0xc3, 0x45, 0x4e, 0x5f, 0x3c, 0x73, 0x8d, 0x2d,
        0x9d, 0x20, 0x13, 0x95, 0xfa, 0xa4, 0xb6, 0x1a,
        0x96, 0xc8
    };

    uint8_t prk[32];
    uint8_t okm[42];

    /* Test HKDF-Extract with no salt */
    if (!tls_hkdf_extract(TLS_HASH_SHA256, NULL, 0,
                          ikm, sizeof(ikm), prk)) {
        return false;
    }

    if (memcmp(prk, expected_prk, sizeof(expected_prk)) != 0) {
        return false;
    }

    /* Test HKDF-Expand with no info */
    if (!tls_hkdf_expand(TLS_HASH_SHA256, prk, sizeof(prk),
                         NULL, 0, okm, sizeof(okm))) {
        return false;
    }

    if (memcmp(okm, expected_okm, sizeof(expected_okm)) != 0) {
        return false;
    }

    return true;
}

/**
 * Test HKDF-Expand-Label for TLS 1.3
 */
static bool test_hkdf_expand_label(void) {
    /* Example from TLS 1.3 spec derivation */
    const uint8_t secret[32] = {
        0x33, 0xad, 0x0a, 0x1c, 0x60, 0x7e, 0xc0, 0x3b,
        0x09, 0xe6, 0xcd, 0x98, 0x93, 0x68, 0x0c, 0xe2,
        0x10, 0xad, 0xf3, 0x00, 0xaa, 0x1f, 0x26, 0x60,
        0xe1, 0xb2, 0x2e, 0x10, 0xf1, 0x70, 0xf9, 0x2a
    };

    const char *label = "c e traffic";
    const uint8_t context[32] = {0};  /* Empty hash */
    uint8_t out[32];

    /* Just test that it doesn't crash and produces output */
    if (!tls_hkdf_expand_label(TLS_HASH_SHA256,
                               secret, sizeof(secret),
                               label, strlen(label),
                               context, sizeof(context),
                               out, sizeof(out))) {
        return false;
    }

    /* Basic sanity check - output should not be all zeros */
    bool all_zero = true;
    for (size_t i = 0; i < sizeof(out); i++) {
        if (out[i] != 0) {
            all_zero = false;
            break;
        }
    }

    return !all_zero;
}

int main(void) {
    gfx_Begin();
    gfx_SetDrawBuffer();
    gfx_FillScreen(0xFF);
    gfx_SetTextFGColor(0x00);

    gfx_PrintStringXY("HKDF Test Suite", 10, 10);
    gfx_PrintStringXY("RFC 5869 Test Vectors", 10, 30);
    gfx_PrintStringXY("", 10, 50);

    gfx_SetTextXY(10, 60);

    /* Run tests */
    bool test1 = test_hkdf_rfc5869_case1();
    print_test_result("RFC 5869 Case 1", test1);

    bool test2 = test_hkdf_rfc5869_case2();
    print_test_result("RFC 5869 Case 2", test2);

    bool test3 = test_hkdf_rfc5869_case3();
    print_test_result("RFC 5869 Case 3", test3);

    bool test4 = test_hkdf_expand_label();
    print_test_result("HKDF-Expand-Label", test4);

    /* Summary */
    gfx_SetTextFGColor(0x00);
    gfx_PrintString("\n");
    if (test1 && test2 && test3 && test4) {
        gfx_SetTextFGColor(2);
        gfx_PrintString("All tests PASSED!");
    } else {
        gfx_SetTextFGColor(224);
        gfx_PrintString("Some tests FAILED!");
    }

    gfx_SwapDraw();

    /* Wait for key */
    while (!kb_AnyKey());

    gfx_End();
    return 0;
}
